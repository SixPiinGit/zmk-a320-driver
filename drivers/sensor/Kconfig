## drivers/sensor/Kconfig
```kconfig
# Copyright (c) 2024 The ZMK Contributors
# SPDX-License-Identifier: MIT

menuconfig INPUT_A320
    bool "A320 touchpad Driver"
    depends on I2C
    help
      Enable driver for A320
```

## dts/bindings/touchpad.yaml
```yaml
description: Avago A320 TouchPad Driver

compatible: "avago,a320"

include: i2c-device.yaml

properties:
    nrst-gpios:
      type: phandle-array
      required: false
      description: |
        nrst pin

    motion-gpios:
      type: phandle-array
      required: false
      description: |
        motion pin

    orient-gpios:
      type: phandle-array
      required: false
      description: |
        orient pin

    shutdown-gpios:
      type: phandle-array
      required: false
      description: |
        shutdown pin
```
